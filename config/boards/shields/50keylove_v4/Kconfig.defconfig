## config/boards/shields/50keylove_v4/Kconfig.defconfig
```kconfig
if SHIELD_50KEYLOVE_V4 || SHIELD_50KEYLOVE_V4_DONGLE || SHIELD_50KEYLOVE_V4_MINIDONGLE

# Name must be less than 16 characters long!
config ZMK_KEYBOARD_NAME
    default "50keylove v4"

endif

if SHIELD_50KEYLOVE_V4_DONGLE

config SPI
    default y

endif

if SHIELD_50KEYLOVE_V4_MINIDONGLE

config I2C
    default y

endif

if LVGL

config LV_Z_VDB_SIZE
    default 64

config LV_DPI_DEF
    default 148

config LV_Z_BITS_PER_PIXEL
    default 1

choice LV_COLOR_DEPTH
    default LV_COLOR_DEPTH_1
endchoice

endif

if SHIELD_50KEYLOVE_V4_DONGLE || SHIELD_50KEYLOVE_V4_MINIDONGLE

config SSD1306
    default y

choice ZMK_DISPLAY_WORK_QUEUE
    default ZMK_DISPLAY_WORK_QUEUE_DEDICATED
endchoice

config ZMK_SPLIT_ROLE_CENTRAL
    default y

config ZMK_SPLIT
    default y

# Set this to the number of peripherals your dongle will have.
# For a unibody, this would be 1. If you have left and right halves, set it to 2, etc.
config ZMK_SPLIT_BLE_CENTRAL_PERIPHERALS
    default 1

# Set this to ZMK_SPLIT_BLE_CENTRAL_PERIPHERALS + your desired number of BT profiles (default is 5)
config BT_MAX_CONN
    default 6

# Set this to the same number as BT_MAX_CONN
config BT_MAX_PAIRED
    default 6

endif
```

## config/boards/shields/50keylove_v4/Kconfig.shield
```kconfig
config SHIELD_50KEYLOVE_V4
    def_bool $(shields_list_contains,50keylove_v4)

config SHIELD_50KEYLOVE_V4_DONGLE
    def_bool $(shields_list_contains,50keylove_v4_dongle)

config SHIELD_50KEYLOVE_V4_MINIDONGLE
    def_bool $(shields_list_contains,50keylove_v4_minidongle)
```

## config/boards/shields/58keylove_v1/Kconfig.defconfig
```kconfig
if SHIELD_58KEYLOVE_V1

# Name must be less than 16 characters long!
config ZMK_KEYBOARD_NAME
    default "58keylove v1"

endif

if SHIELD_58KEYLOVE_V1_MINIDONGLE

# Max 16 characters in keyboard name
config ZMK_KEYBOARD_NAME
    default "58keylovedongle"

config ZMK_SPLIT_ROLE_CENTRAL
    default y

config ZMK_SPLIT
    default y

config ZMK_SPLIT_BLE_CENTRAL_PERIPHERALS
    default 1

config BT_MAX_CONN
    default 6

config BT_MAX_PAIRED
    default 6

config I2C
    default y

config SSD1306
    default y

choice ZMK_DISPLAY_WORK_QUEUE
    default ZMK_DISPLAY_WORK_QUEUE_DEDICATED
endchoice

endif

if LVGL

config LV_Z_VDB_SIZE
    default 64

config LV_DPI_DEF
    default 148

config LV_Z_BITS_PER_PIXEL
    default 1

choice LV_COLOR_DEPTH
    default LV_COLOR_DEPTH_1
endchoice

endif
```

## config/boards/shields/58keylove_v1/Kconfig.shield
```kconfig
config SHIELD_58KEYLOVE_V1
    def_bool $(shields_list_contains,58keylove_v1)

config SHIELD_58KEYLOVE_V1_MINIDONGLE
    def_bool $(shields_list_contains,58keylove_v1_minidongle)
```
